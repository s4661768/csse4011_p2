## CMakeLists.txt
```
# SPDX-License-Identifier: Apache-2.0

cmake_minimum_required(VERSION 3.20.0)
find_package(Zephyr REQUIRED HINTS $ENV{ZEPHYR_BASE})
project(bluetooth_shell)

zephyr_library_include_directories(${ZEPHYR_BASE}/samples/bluetooth)

set(HEADER_FILES ./src/main.h ./src/uart_th.h ./src/shell_commands.h ./src/bluetooth_send_recv.h)

target_sources(app PRIVATE src/main.c ./src/uart_th.c ./src/shell_commands.c ./src/bluetooth_send_recv.c)
```

## prj.conf
```kconfig
# GPIO Configs
CONFIG_GPIO=y

# LOG Configs
CONFIG_SHELL=y
CONFIG_SHELL_TAB=y
CONFIG_SHELL_TAB_AUTOCOMPLETION=y
CONFIG_SHELL_BACKEND_RTT=y
# CONFIG_SHELL_BACKEND_SERIAL=y
CONFIG_LOG=y
CONFIG_LOG_CMDS=y
CONFIG_LOG_RUNTIME_FILTERING=y
CONFIG_SHELL_LOG_BACKEND=y

# # UART Configs
CONFIG_SERIAL=y
CONFIG_UART_INTERRUPT_DRIVEN=y



CONFIG_BT=y
CONFIG_BT_OBSERVER=y



# Increased stack due to settings API usage
CONFIG_SYSTEM_WORKQUEUE_STACK_SIZE=2048

# CONFIG_TEST=y
# CONFIG_TEST_LOGGING_DEFAULTS=n
# CONFIG_BT=y
# CONFIG_LOG=y
# CONFIG_BT_CENTRAL=y
# CONFIG_BT_PERIPHERAL=y
# CONFIG_BT_PRIVACY=y
# CONFIG_BT_SMP=y
# CONFIG_BT_PASSKEY_KEYPRESS=y
# CONFIG_BT_SIGNING=y
# CONFIG_BT_FIXED_PASSKEY=y
# CONFIG_BT_ATT_PREPARE_COUNT=2
# CONFIG_BT_GATT_CLIENT=y
# CONFIG_BT_L2CAP_DYNAMIC_CHANNEL=y
# CONFIG_BT_TINYCRYPT_ECC=y
# CONFIG_BT_SHELL=y
# CONFIG_BT_DEVICE_NAsE_DYNAMIC=y
# CONFIG_BT_L2CAP_TX_BUF_COUNT=4
# CONFIG_BT_ID_MAX=2
# CONFIG_BT_EATT=y
# CONFIG_BT_L2CAP_ECRED=y
# CONFIG_BT_GATT_DYNAMIC_DB=y
# CONFIG_BT_GATT_NOTIFY_MULTIPLE=y
# CONFIG_BT_HRS=y
# CONFIG_BT_FILTER_ACCEPT_LIST=y
# CONFIG_BT_REMOTE_INFO=y
# CONFIG_BT_REMOTE_VERSION=y
# CONFIG_BT_GATT_AUTO_DISCOVER_CCC=y

# CONFIG_BT_SETTINGS=y
# CONFIG_FLASH=y
# CONFIG_FLASH_PAGE_LAYOUT=y
# CONFIG_FLASH_MAP=y
# CONFIG_NVS=y
# CONFIG_SETTINGS=y

# CONFIG_BT_EXT_ADV=y
# CONFIG_BT_EXT_ADV_LEGACY_SUPPORT=y
# CONFIG_BT_PER_ADV=y
# CONFIG_BT_PER_ADV_SYNC=y

# CONFIG_BT_USER_DATA_LEN_UPDATE=y
# CONFIG_BT_AUTO_DATA_LEN_UPDATE=y

# CONFIG_BT_USER_PHY_UPDATE=y
# CONFIG_BT_AUTO_PHY_UPDATE=y

# CONFIG_BT_ISO_BROADCASTER=y
# CONFIG_BT_ISO_SYNC_RECEIVER=y
# CONFIG_BT_ISO_CENTRAL=y
# CONFIG_BT_ISO_PERIPHERAL=y

# Usage:
# `kernel log-level modulename severity`
# e.g.,
#
# kernel log-level bt_hci_core 0
# kernel log-level bt_l2cap 2
# kernel log-level bt_att 4
# CONFIG_LOG_RUNTIME_FILTERING=y

# # Errno message table. Disable to save ROM.
# CONFIG_MINIMAL_LIBC_STRING_ERROR_TABLE=y
```

## src/main.c
```c
/** @file
 *  @brief Interactive Bluetooth LE shell application
 *
 *  Application allows implement Bluetooth LE functional commands performing
 *  simple diagnostic interaction between LE host stack and LE controller
 */

/*
 * Copyright (c) 2017 Nordic Semiconductor ASA
 * Copyright (c) 2015-2016 Intel Corporation
 *
 * SPDX-License-Identifier: Apache-2.0
 */

#include <errno.h>
#include <stddef.h>
#include <stdlib.h>
#include <string.h>
#include <version.h>
#include <zephyr/drivers/gpio.h>
#include <zephyr/drivers/uart.h>
#include <zephyr/kernel.h>
#include <zephyr/shell/shell.h>
#include <zephyr/sys/byteorder.h>
#include <zephyr/sys/printk.h>
#include <zephyr/types.h>
#include <zephyr/usb/usb_device.h>

#include <zephyr/shell/shell.h>

#include <zephyr/bluetooth/bluetooth.h>
#include <zephyr/bluetooth/hci.h>
#include <zephyr/bluetooth/services/hrs.h>
#include <zephyr/bluetooth/uuid.h>

#include "bluetooth_send_recv.h"
#include "main.h"
#include "shell_commands.h"
#include "uart_th.h"

#ifdef CONFIG_ARCH_POSIX
#include <unistd.h>
#else
#include <zephyr/posix/unistd.h>
#endif

LOG_MODULE_REGISTER(stage_2);
extern struct k_msgq uart_msgq;

// Thread Macros
#define SHELL_TH_STACKSIZE KB(2)
#define CONTROLLER_TH_STACKSIZE KB(1)

#define SHELL_TH_PRIORITY 7
#define CONTROLLER_TH_PRIORITY 6

char LED_Info[5] = {'0', '0', '0', '0', '0'};
#define AHU_LED_QUEUE_LEN 1
#define AHU_LED_MSG_SIZE sizeof(LED_Info)
K_MSGQ_DEFINE(Ahu_led_msg_q, AHU_LED_MSG_SIZE, AHU_LED_QUEUE_LEN, 4);

/* The devicetree node identifier for the "led0" alias. */
#define LED0_NODE DT_ALIAS(led0)
#define LED1_NODE DT_ALIAS(led1)
#define LED2_NODE DT_ALIAS(led2)
#define LED3_NODE DT_ALIAS(led3)

/*
 * A build error on this line means your board is unsupported.
 * See the sample documentation for information on how to fix this.
 */
static const struct gpio_dt_spec led0 = GPIO_DT_SPEC_GET(LED0_NODE, gpios);
static const struct gpio_dt_spec led1 = GPIO_DT_SPEC_GET(LED1_NODE, gpios);
static const struct gpio_dt_spec led2 = GPIO_DT_SPEC_GET(LED2_NODE, gpios);
static const struct gpio_dt_spec led3 = GPIO_DT_SPEC_GET(LED3_NODE, gpios);
static const struct gpio_dt_spec Leds[] = {led0, led1, led2, led3};

#define DEVICE_NAME CONFIG_BT_DEVICE_NAME

/**
 * This threads initialises the board LEDs and sets them based on the received
 * shell command.
 */
int controller_th(void) {
    uint8_t led_states[] = {1, 1, 1, 1};

    int ret;
    if (!gpio_is_ready_dt(&led0) || !gpio_is_ready_dt(&led1) || !gpio_is_ready_dt(&led2) ||
        !gpio_is_ready_dt(&led3)) {
        return 0;
    }

    ret = gpio_pin_configure_dt(&led0, GPIO_OUTPUT_ACTIVE);
    if (ret < 0) {
        return 0;
    }
    ret = gpio_pin_configure_dt(&led1, GPIO_OUTPUT_ACTIVE);
    if (ret < 0) {
        return 0;
    }
    ret = gpio_pin_configure_dt(&led2, GPIO_OUTPUT_ACTIVE);
    if (ret < 0) {
        return 0;
    }
    ret = gpio_pin_configure_dt(&led3, GPIO_OUTPUT_ACTIVE);
    if (ret < 0) {
        return 0;
    }

    char l[] = {'0', '0', '0', '0', '0'};

    while (1) {
        if (k_msgq_get(&Ahu_led_msg_q, &l, K_TIMEOUT_ABS_TICKS(10)) == 0) {
            if (l[0] == '1') { // Set CMD
                for (int i = 0; i < 4; i++) {
                    if (l[i + 1] == '1') {        // Set LED
                        if (led_states[i] != 1) { // If LED isn't already on
                            gpio_pin_set_dt(&(Leds[i]), 1);
                            led_states[i] = 1;
                            LOG_INF("LED Set");
                        } else {
                            LOG_WRN("LED is already already on.");
                        }

                    } else {
                        if (led_states[i] != 0) {
                            gpio_pin_set_dt(&(Leds[i]), 0);
                            led_states[i] = 0;
                            LOG_INF("LED Cleared");
                        } else {
                            LOG_WRN("LED is already already off.");
                        }
                    }
                }

            } else {

                for (int i = 0; i < 4; i++) {
                    if (l[i + 1] == '1') { // Toggle LED

                        gpio_pin_toggle_dt(&(Leds[i]));
                        led_states[i] = (1 + led_states[i]) % 2;
                        LOG_INF("LED Toggle");
                    }
                }
            }
        }

        k_yield();
    }

    return 0;
}

K_THREAD_DEFINE(uart_send_th_id, UART_TH_STACKSIZE, uart_send_th, NULL, NULL, NULL,
                UART_TH_PRIORITY, 0, 0);
K_THREAD_DEFINE(controller_th_id, CONTROLLER_TH_STACKSIZE, controller_th, NULL, NULL, NULL,
                CONTROLLER_TH_PRIORITY, 0, 0);
K_THREAD_DEFINE(send_data_th_id, SEND_DATA_TH_STACKSIZE, send_data_th, NULL, NULL, NULL,
                SEND_DATA_TH_PRIORITY, 0, 0);
```

## src/bluetooth_send_recv.c
```c
#include <stdlib.h>
#include <string.h>
#include <zephyr/kernel.h>
#include <zephyr/logging/log.h>
#include <zephyr/shell/shell.h>

#include <zephyr/bluetooth/bluetooth.h>
#include <zephyr/bluetooth/hci.h>

#include "bluetooth_send_recv.h"
#include "main.h"
#include "shell_commands.h"
#include "uart_th.h"

#define NAME_LEN 30

#define MAJOR_1 25
#define MAJOR_2 MAJOR_1 + 1
#define MINOR_1 27
#define MINOR_2 MINOR_1 + 1

// #define SCAN_DURATION 1000 // Milliseconds

extern struct k_msgq uart_msgq;
struct k_msgq bt_data_msgq;

LOG_MODULE_DECLARE(stage_2);

K_MSGQ_DEFINE(send_data_msgq, sizeof(uint8_t), 10, 4);
K_MSGQ_DEFINE(bt_data_msgq, sizeof(uint8_t) * 4, 10, 4);

uint8_t filter_adv = 0;
static bt_addr_le_t filter_addr, filter_con;

/**
 * This function is a callback function for bt_le_scan_start function called from the blescan
 * function. It prints the information for all of the packets it receives.
 */
static void device_found(const bt_addr_le_t *addr, int8_t rssi, uint8_t type,
                         struct net_buf_simple *ad) {
    char addr_str[BT_ADDR_LE_STR_LEN];

    bt_addr_le_to_str(addr, addr_str, sizeof(addr_str));

    LOG_INF("Device found: %s (RSSI %d), type %u, AD data len %u\n", addr_str, rssi, type, ad->len);
}

/**
 * This function is a callback function for bt_le_scan_start function called from the blescan
 * function in filter mode. It filters for the given device address and then prints its information
 * to the shell.
 */
static void device_found_filter(const bt_addr_le_t *addr, int8_t rssi, uint8_t type,
                                struct net_buf_simple *ad) {
    char addr_str[BT_ADDR_LE_STR_LEN];

    bt_addr_le_to_str(addr, addr_str, sizeof(addr_str));

    /* Check if the source address of the received packet matches that address we are filtering for.
     */
    if (bt_addr_le_eq(addr, &filter_addr) == true) {
        LOG_INF("Device found: %s (RSSI %d), type %u, AD data len %u\n", addr_str, rssi, type,
                ad->len);
    }
}

/**
 * This function is a callback function for bt_le_scan_start function called from the blecon
 * function. It filters for the given device address and then read the major and minor bytes if the
 * packet is an iBeacon packet. Once is has read the data out it sends it to a queue.
 */
static void device_found_con(const bt_addr_le_t *addr, int8_t rssi, uint8_t type,
                             struct net_buf_simple *ad) {
    char addr_str[BT_ADDR_LE_STR_LEN];

    bt_addr_le_to_str(addr, addr_str, sizeof(addr_str));

    if (bt_addr_le_eq(addr, &filter_con) == true) {

        bt_addr_le_to_str(addr, addr_str, sizeof(addr_str));

        /* Check if this packet is an iBeacon packet. */
        if ((ad->data[5] == 0x4c) && (ad->data[6] == 0x00) && (ad->data[7] == 0x02) &&
            (ad->data[8] == 0x15)) {

            uint8_t data[4];
            data[0] = ad->data[MAJOR_1];
            data[1] = ad->data[MAJOR_2];
            data[2] = ad->data[MINOR_1];
            data[3] = ad->data[MINOR_2];

            if (k_msgq_put(&bt_data_msgq, &data, K_MSEC(10)) != 0) {
                LOG_INF("Couldn't put data in bt_data_msgq\r\n");
            }
        }
    }
}

/**
 * This thread sends data to the GCU depending on the current device ID.
 */
int send_data_th(void) {

    uint8_t dev_id = 0;
    uint16_t temp_value = 0;
    uint16_t integers = 0;
    uint16_t decimal = 0;
    uint8_t recv_data[4];

    while (1) {

        if ((dev_id != DEV_ID_NONE) && (dev_id != DEV_ID_TVOC)) {
            integers = temp_value / 100;
            decimal = temp_value % 100;

            uart_msg um;
            um.type = DATA_SEND_TYPE;
            um.length = 8;
            uint8_t data[6] = {dev_id,
                               ((integers >> 8) & 0xFF) | (0x80),
                               (integers & 0xFF),
                               ((decimal >> 8) & 0xFF) | (0x80),
                               (decimal & 0xFF),
                               '\0'};
            um.data = data;
            build_uart_msg(&um);

            if (k_msgq_put(&uart_msgq, &um.msg, K_NO_WAIT) == 0) {
                // LOG_INF("DATA_SEND\tMSG put in queue\r\n");
            } else {
                LOG_ERR("DATA_SEND\tMSG failed to be put in queue\r\n");
            }
        } else if (dev_id == DEV_ID_TVOC) {
            integers = temp_value / 10;
            decimal = temp_value % 10;

            uart_msg um;
            um.type = DATA_SEND_TYPE;
            um.length = 8;
            uint8_t data[6] = {dev_id,
                               ((integers >> 8) & 0xFF) | (0x80),
                               (integers & 0xFF),
                               ((decimal >> 8) & 0xFF) | (0x80),
                               (decimal & 0xFF),
                               '\0'};
            um.data = data;
            build_uart_msg(&um);

            if (k_msgq_put(&uart_msgq, &um.msg, K_NO_WAIT) == 0) {
                // LOG_INF("DATA_SEND\tMSG put in queue\r\n");
            } else {
                LOG_ERR("DATA_SEND\tMSG failed to be put in queue\r\n");
            }
        }

        if (k_msgq_get(&send_data_msgq, &dev_id, K_MSEC(100)) == 0) {
            // LOG_INF("Recved Dev ID: %d\r\n", dev_id);
        }

        if (k_msgq_get(&bt_data_msgq, &recv_data, K_MSEC(10)) == 0) {
            if (dev_id == recv_data[0]) { // If the received data matches the current device id
                temp_value = (recv_data[2] << 8) | recv_data[3];

                LOG_INF("Received Bluetooth Packet: %d - %d\r\n", recv_data[0], temp_value);
                // LOG_INF("Integer Dec: %d Hex: %02X\r\n", integers, integers);
                // LOG_INF("Decimal Dec: %d Hex: %02X\r\n", decimal, decimal);
            }
        }

        k_sleep(K_MSEC(200));
    }
}

/**
 * Callback for the bluetooth 'blescan' shell command.
 */
void blescan_h(const struct shell *shell, size_t argc, char *argv[]) {

    if (argc == 2) {
        if (strcmp(argv[1], "-s") == 0) {
            LOG_INF("btscan START\r\n");
            struct bt_le_scan_param scan_param = {
                .type = BT_LE_SCAN_TYPE_PASSIVE,
                .options = BT_LE_SCAN_OPT_NONE,
                .interval = BT_GAP_SCAN_SLOW_INTERVAL_1,
                .window = BT_GAP_SCAN_FAST_WINDOW,
            };
            int err = bt_le_scan_start(&scan_param, device_found);
            if (err) {
                printk("Start scanning failed (err %d)\n", err);
                return;
            }

            printk("Started scanning...\n");

        } else if (strcmp(argv[1], "-p") == 0) {

            int err = bt_le_scan_stop();
            if (err) {
                LOG_ERR("Scan stop failed (err %d)\n", err);
                return;
            }
            LOG_INF("btscan STOP\r\n");
        } else {
            LOG_WRN("Incorrect input arguments\r\n");
        }

    } else if (argc == 4) {
        if ((strcmp(argv[1], "-s") == 0) && (strcmp(argv[2], "-f") == 0)) {
            LOG_INF("btscan START with filter\r\n");
            struct bt_le_scan_param scan_param = {
                .type = BT_LE_SCAN_TYPE_PASSIVE,
                .options = BT_LE_SCAN_OPT_FILTER_DUPLICATE,
                .interval = BT_GAP_SCAN_FAST_INTERVAL,
                .window = BT_GAP_SCAN_FAST_WINDOW,
            };
            int err;

            int ret = bt_addr_le_from_str(argv[3], "random", &filter_addr);

            if (ret) {
                printk("Invalid address (err %d)\n", -EINVAL);
                return;
            }

            err = bt_le_scan_start(&scan_param, device_found_filter);
            if (err) {
                printk("Start scanning failed (err %d)\n", err);
                return;
            }
            printk("Started scanning...\n");

            ret = bt_addr_le_from_str(argv[3], "random", &filter_addr);
        }

    } else {
        LOG_WRN("Incorrect input arguments\r\n");
    }

    return;
}

/**
 * Callback for the bluetooth 'bleinit' shell command.
 */
void bleinit_h(const struct shell *shell, size_t argc, char *argv[]) {

    int err = bt_enable(NULL);
    bt_set_name("Ya mums old nokia\r\n");
    if (err) {
        LOG_ERR("Bluetooth initialization failed (err %d)\n", err);
    }
}

/**
 * Callback for the bluetooth 'bleshutdown' shell command.
 */
void bleshutdown_h(const struct shell *shell, size_t argc, char *argv[]) {

    int err = bt_disable();
    if (err) {
        LOG_ERR("Bluetooth shutdown failed (err %d)\n", err);
    }

    uint8_t dev_id = GCU_STOP_DATA_SEND;
    if (k_msgq_put(&send_data_msgq, &dev_id, K_MSEC(40)) == 0) {
        // LOG_INF("Dev id from GCUREC\tMSG put in queue\r\n");
    }
}

/**
 * Callback for the bluetooth 'blecon' shell command.
 */
void blecon_h(const struct shell *shell, size_t argc, char *argv[]) {

    if (argc == 3) {
        if ((strcmp(argv[1], "-s") == 0)) {
            struct bt_le_scan_param scan_param = {
                .type = BT_LE_SCAN_TYPE_PASSIVE,
                .options = BT_LE_SCAN_OPT_NONE,
                .interval = BT_GAP_SCAN_FAST_INTERVAL,
                .window = BT_GAP_SCAN_FAST_WINDOW,
            };
            int err;

            int ret = bt_addr_le_from_str(argv[2], "random", &filter_con);

            if (ret) {
                printk("Invalid address (err %d)\n", -EINVAL);
                return;
            }

            err = bt_le_scan_start(&scan_param, device_found_con);
            if (err) {
                printk("Start connection failed (err %d)\n", err);
                return;
            }
            shell_print(shell, "Starting Connection...\n");
        }
    } else if (argc == 2) {
        if ((strcmp(argv[1], "-p") == 0)) {
            int err = bt_le_scan_stop();
            if (err) {
                LOG_ERR("Connection close failed (err %d)\n", err);
                return;
            }

            uint8_t dev_id = GCU_STOP_DATA_SEND;
            if (k_msgq_put(&send_data_msgq, &dev_id, K_MSEC(40)) == 0) {
                // LOG_INF("Dev id from GCUREC\tMSG put in queue\r\n");
            }

            shell_print(shell, "Connection closed\r\n");
        }
    } else {
        LOG_WRN("Incorrect input arguments\r\n");
    }
}

/* Registering bluetooth related shell cmds */
SHELL_CMD_ARG_REGISTER(blescan, NULL,
                       "Scans for bluetooth devices\r\nFormat:\r\n blescan "
                       "<s/p> -[f filter: <BLE ADDR>]\r\n",
                       blescan_h, 2, 2);
SHELL_CMD_ARG_REGISTER(bleinit, NULL, "Initialise and start bluetooth\r\n", bleinit_h, 0, 0);
SHELL_CMD_ARG_REGISTER(bleshutdown, NULL, "Initialise and start bluetooth\r\n", bleshutdown_h, 0,
                       0);
SHELL_CMD_ARG_REGISTER(blecon, NULL, "Listens to advertisements from specified source\r\n",
                       blecon_h, 2, 1);
```

## src/bluetooth_send_recv.h
```c
#ifndef __BLUETOOTH_SEND_RECV_H__
#define __BLUETOOTH_SEND_RECV_H__

#define SEND_DATA_TH_PRIORITY 7
#define SEND_DATA_TH_STACKSIZE KB(1)

#define DEV_ID_TEMP 5
#define DEV_ID_HUM 6
#define DEV_ID_PRES 7
#define DEV_ID_TVOC 8
#define DEV_ID_NONE 0x00

int send_data_th(void);

#endif
```

## src/main.h
```c
#ifndef __MAIN_H__
#define __MAIN_H__

#include <stdlib.h>

// GCU Command types
#define POINT 0
#define CIRCLE 1
#define LISSA 2
#define DAC 3
#define GLED 4
#define GPD 5

typedef struct LED_Update {
    uint8_t t; // Flag for toggle. If 1, a toggle is being requested, otherwise a set is being
               // requested.
    char *l;   // Bit mask being sent
} LED_Update;

#endif
```

## src/shell_commands.c
```c
#include <stdlib.h>
#include <zephyr/kernel.h>
#include <zephyr/logging/log.h>
#include <zephyr/shell/shell.h>
#include "shell_commands.h"
#include "main.h"
#include "uart_th.h"

LOG_MODULE_DECLARE(stage_2);
extern char LED_Info[]; // TODO fix this to not be a global
extern struct k_msgq uart_msgq;
extern struct k_msgq send_data_msgq;
extern struct k_msgq Ahu_led_msg_q;

// 						DEFINING CUSTOM SHELL COMMANDS
int led_set(const struct shell *shell, size_t argc, char *argv[]) {

    if (strlen(argv[1]) != 4) {
        shell_print(shell, "Incorrect argument. Bitmask must be 4 bits long and can only contains "
                           "1s and 0s-> <0101>.\r\n");
        return 0;
    }

    /* Checking the bit mask consists of only 1s and 0s. */
    for (int i = 0; i < 4; i++) {
        if ((argv[1][i] != '0') && (argv[1][i] != '1')) {
            shell_print(shell, "Incorrect argument. Bitmask must be 4 bits long and can only "
                               "contains 1s and 0s-> <0101>.\r\n");
            return 0;
        }
    }

    LED_Info[0] = '1';
    LED_Info[1] = argv[1][0];
    LED_Info[2] = argv[1][1];
    LED_Info[3] = argv[1][2];
    LED_Info[4] = argv[1][3];
    k_msgq_put(&Ahu_led_msg_q, LED_Info, K_MSEC(50));
    return 0;
}

int led_toggle(const struct shell *shell, size_t argc, char *argv[]) {

    if (strlen(argv[1]) != 4) {
        shell_print(shell, "Incorrect argument. Bitmask must be 4 bits long and can only contains "
                           "1s and 0s-> <0101>.\r\n");
        return 0;
    }

    /* Checking the bit mask consists of only 1s and 0s. */
    for (int i = 0; i < 4; i++) {
        if ((argv[1][i] != '0') && (argv[1][i] != '1')) {
            shell_print(shell, "Incorrect argument. Bitmask must be 4 bits long and can only "
                               "contains 1s and 0s-> <0101>.\r\n");
            return 0;
        }
    }

    LED_Info[0] = '0';
    LED_Info[1] = argv[1][0];
    LED_Info[2] = argv[1][1];
    LED_Info[3] = argv[1][2];
    LED_Info[4] = argv[1][3];
    k_msgq_put(&Ahu_led_msg_q, LED_Info, K_MSEC(50));
    return 0;
}

int system_timer_read(const struct shell *shell, size_t argc, char *argv[]) {

    if (argc == 1) {
        int64_t tot_sec = k_cyc_to_ns_floor64(sys_clock_tick_get()) / NSEC_PER_MSEC / MSEC_PER_SEC;
        shell_fprintf(shell, SHELL_INFO, "%lld Seconds\r\n", tot_sec);

    } else if (argc == 2) {
        if ((strcmp(argv[1], "f")) == 0) {
            int64_t tot_sec =
                k_cyc_to_ns_floor64(sys_clock_tick_get()) / NSEC_PER_MSEC / MSEC_PER_SEC;
            int64_t tot_min = tot_sec / SEC_PER_MIN;
            int64_t min = tot_min % MIN_PER_HOUR;
            int64_t hour = tot_min / MIN_PER_HOUR;
            shell_fprintf(shell, SHELL_INFO, "%lld:%lld:%lld\r\n", hour, min, tot_sec % 60);
        }
    }

    return 0;
}

int point_h(const struct shell *shell, size_t argc, char *argv[]) {

    if (argc == 3) {
        LOG_DBG("Point cmd called.\r\n");

        uint8_t num1, num2;
        num1 = atoi(argv[1]);
        num2 = atoi(argv[2]);

        /* Error Checking. */
        if ((num1 > 33 || num1 < 0) || (num2 > 33 || num2 < 0)) {
            LOG_WRN("Incorrect arguments. Arguments out of range.\r\n");
            return 0;
        }

        uart_msg um;

        um.type = POINT_TYPE;
        um.length = 3;
        uint8_t data[3] = {num1, num2, '\0'};
        um.data = data;
        build_uart_msg(&um);

        if (k_msgq_put(&uart_msgq, &um.msg, K_NO_WAIT) == 0) {
            LOG_INF("POINT\tMSG put in queue\r\n");
        } else {
            LOG_ERR("POINT\tMSG failed to be put in queue\r\n");
        }

    } else {
        shell_print(shell, "Incorrect Point cmd format.\r\n");
    }

    return 0;
}

int move_c_h(const struct shell *shell, size_t argc, char *argv[]) {
    if (argc == 3) {
        LOG_DBG("MOVE_CIRCLE cmd called.\r\n");

        uint8_t num1, num2;
        num1 = atoi(argv[1]);
        num2 = atoi(argv[2]);

        /* Error Checking. */
        if ((num1 > 33 || num1 < 0) || (num2 > 33 || num2 < 0)) {
            LOG_WRN("Incorrect arguments. Arguments out of range.\r\n");
            return 0;
        }

        uart_msg um;

        um.type = MOVE_CIRCLE_TYPE;
        um.length = 3;
        uint8_t data[3] = {num1, num2, '\0'};
        um.data = data;
        build_uart_msg(&um);

        if (k_msgq_put(&uart_msgq, &um.msg, K_NO_WAIT) == 0) {
            LOG_INF("MOVE_CIRCLE\tMSG put in queue\r\n");
        } else {
            LOG_ERR("MOVE_CIRCLE\tMSG failed to be put in queue\r\n");
        }

    } else {
        shell_print(shell, "Incorrect Point cmd format.\r\n");
    }

    return 0;
}

int circle_h(const struct shell *shell, size_t argc, char *argv[]) {

    if (argc == 4) {
        LOG_DBG("Circle cmd called.\r\n");

        uint8_t num1, num2, num3;
        num1 = atoi(argv[1]);
        num2 = atoi(argv[2]);
        num3 = atoi(argv[3]);

        /* Error Checking. */
        if ((num1 > 33 || num1 < 0) || (num2 > 33 || num2 < 0) || (num3 > 33 || num3 < 0)) {
            LOG_WRN("Incorrect arguments. Arguments out of range.\r\n");
            return 0;
        }

        uart_msg um;

        um.type = CIRCLE_TYPE;
        um.length = 4;
        uint8_t data[4] = {num1, num2, num3, '\0'};
        um.data = data;
        build_uart_msg(&um);

        if (k_msgq_put(&uart_msgq, &um.msg, K_NO_WAIT) == 0) {
            LOG_INF("CIRCLE\tMSG put in queue\r\n");
        } else {
            LOG_ERR("CIRCLE\tMSG failed to be put in queue\r\n");
        }
    } else {
        shell_print(shell, "Incorrect Circle cmd format.\r\n");
    }

    return 0;
}

int lissajous_h(const struct shell *shell, size_t argc, char *argv[]) {
    if (argc == 5) {
        uint8_t num1, num2;
        uint32_t temp_num3;

        num1 = atoi(argv[2]);
        num2 = atoi(argv[3]);
        temp_num3 = atoi(argv[4]);

        /* Error Checking. */
        if ((num1 > 33 || num1 < 0) || (num2 > 33 || num2 < 0) ||
            (temp_num3 > 65536 || temp_num3 < 0)) {
            LOG_WRN("Incorrect arguments. Arguments out of range.\r\n");
            return 0;
        } else if ((strcmp(argv[1], "x") != 0) && (strcmp(argv[1], "y") != 0)) {
            LOG_WRN("Incorrect arguments. First argument should be lowercase 'x' or "
                    "'y'.\r\n");
            return 0;
        }

        uint16_t num3 = (temp_num3 & 0xFFFF);

        uart_msg um;
        um.type = LCP_TYPE;
        um.length = 6;
        uint8_t xy = 2;
        if (strcmp(argv[1], "x") == 0) {
            xy = LCP_X;
        } else {
            xy = LCP_Y;
        }
        LOG_INF("Sinusoid:%d\r\nNUM1:%d\r\nNUM2:%d\r\nNUM3:%d", xy, num1, num2, num3);

        /* Masking and shifting 16 bit number into 2 8 bit numbers. */
        uint8_t period_upper = (num3 >> 8) & 0xFF;
        uint8_t period_lower = num3 & 0xFF;
        LOG_INF("upper:%d\r\nlower:%d\r\n", period_upper, period_lower);

        uint8_t data[6] = {xy, num1, num2, period_upper, period_lower, '\0'};
        um.data = data;
        build_uart_msg(&um);

        if (k_msgq_put(&uart_msgq, &um.msg, K_MSEC(10)) == 0) {
            LOG_INF("LJ\tMSG put in queue\r\n");
        } else {
            LOG_INF("LJ\tMSG failed to be put in queue\r\n");
        }

    } else {
        shell_print(shell, "Incorrect Lissajous cmd format.\r\n");
    }

    return 0;
}

int dac_h(const struct shell *shell, size_t argc, char *argv[]) {
    uint8_t num1, num2;

    if (argc == 3) {

        num1 = atoi(argv[1]);
        num2 = atoi(argv[2]);
        if ((num1 > 33 || num1 < 0) || (num2 > 33 || num2 < 0)) {
            LOG_WRN("Incorrect arguments. Arguments out of range.\r\n");
            return 0;
        }

        /* Make and send message to set DAC X voltage. */
        uart_msg um;
        um.type = 2;
        um.length = 3;
        uint8_t data[3] = {DAC_X, num1, '\0'};
        um.data = data;
        build_uart_msg(&um);

        if (k_msgq_put(&uart_msgq, &um.msg, K_MSEC(10)) == 0) {
            LOG_INF("DAC\tMSG put in queue\r\n");
        } else {
            LOG_INF("DAC\tMSG failed to be put in queue\r\n");
        }

        /* Make and send message to set DAC Y voltage. */
        uint8_t data2[3] = {DAC_Y, num2, '\0'};
        uart_msg um2;
        um2.type = 2;
        um2.length = 3;
        um2.data = data2;

        if (k_msgq_put(&uart_msgq, &um2.msg, K_MSEC(10)) == 0) {
            LOG_INF("DAC\tMSG put in queue\r\n");
        } else {
            LOG_INF("DAC\tMSG failed to be put in queue\r\n");
        }

    } else {
        LOG_WRN("Incorrect DAC cmd format.\r\n");
    }

    return 0;
}

int gled_h(const struct shell *shell, size_t argc, char *argv[]) {
    if (argc == 4) {
        uint8_t num = 0;
        for (int i = 1; i < 4; i++) {
            if ((strcmp(argv[i], "1") != 0) && (strcmp(argv[i], "0") != 0)) {
                LOG_INF("Arg: %s\t%d\r\n", argv[i], i);
                shell_print(shell, "Incorrect GCU LED cmd format. Only takes in 0 and 1.\r\n");
                return 0;
            }

            if (strcmp(argv[i], "1") == 0) {
                switch (i) {

                case 1:
                    num |= (1 << 2);
                    break;

                case 2:
                    num |= (1 << 1);
                    break;

                case 3:
                    num |= (1 << 0);
                    break;
                }
            }
        }

        LOG_INF("Num: %d\r\n", num);

        uint8_t data[3] = {1, num, '\0'};
        uart_msg um;
        um.type = LEDS_TYPE;
        um.length = 3;
        um.data = data; // Set mode
        build_uart_msg(&um);

        if (k_msgq_put(&uart_msgq, &um.msg, K_MSEC(40)) == 0) {
            LOG_INF("GLED\tMSG put in queue\r\n");
        } else {
            LOG_INF("GLED\tMSG failed to be put in queue\r\n");
        }

    } else {
        shell_print(shell, "Incorrect GCU LED cmd format.\r\n");
    }

    return 0;
}

int gpd_h(const struct shell *shell, size_t argc, char *argv[]) {
    if (argc == 1) {
        uart_msg um;

        build_uart_msg(&um);
    } else {
        shell_print(shell, "Incorrect GPD cmd format.\r\n");
    }

    return 0;
}

int gcugraph_h(const struct shell *shell, size_t argc, char *argv[]) {

    if (argc == 2) {
        LOG_DBG("GCU GRAPH cmd called.\r\n");

        uint8_t dev_id = atoi(argv[1]);

        /* Error Checking. */
        if ((dev_id > 8 || dev_id < 5 || dev_id == 0)) {
            LOG_WRN("Invalid device ID. Valid device IDs are:\r\n5 -> Temperature\r\n6 "
                    "-> Humidity\r\n7 -> Air pressure\r\n8 -> TVOC\r\n");
            return 0;
        }

        uart_msg um;

        um.type = GCU_GRAPH_TYPE;
        um.length = 2;
        uint8_t data[2] = {1, '\0'};
        um.data = data;
        build_uart_msg(&um);

        if (k_msgq_put(&uart_msgq, &um.msg, K_MSEC(40)) == 0) {
            LOG_INF("GCUGRAPH\tMSG put in queue\r\n");
        } else {
            LOG_ERR("GCUGRAPH\tMSG failed to be put in queue\r\n");
        }

        if (k_msgq_put(&send_data_msgq, &dev_id, K_MSEC(40)) == 0) {
            LOG_INF("Dev id from GCUGRAPH\tMSG put in queue\r\n");
        } else {
            LOG_ERR("Dev id from GCUGRAPH\tMSG failed to be put in queue\r\n");
        }

    } else {
        shell_print(shell, "Incorrect GCUGRAPH cmd format.\r\n");
    }

    return 0;
}

int gcumeter_h(const struct shell *shell, size_t argc, char *argv[]) {

    if (argc == 2) {
        LOG_DBG("GCUMETER cmd called.\r\n");

        uint8_t dev_id = atoi(argv[1]);

        /* Error Checking. */
        if ((dev_id > 8 || dev_id < 5 || dev_id == 0)) {
            LOG_WRN("Invalid device ID. Valid device IDs are:\r\n5 -> Temperature\r\n6 "
                    "-> Humidity\r\n7 -> Air pressure\r\n8 -> TVOC\r\n");
            return 0;
        }

        uart_msg um;

        um.type = GCU_METER_TYPE;
        um.length = 2;
        uint8_t data[2] = {1, '\0'};
        um.data = data;
        build_uart_msg(&um);

        if (k_msgq_put(&uart_msgq, &um.msg, K_MSEC(40)) == 0) {
            LOG_INF("GCUMETER\tMSG put in queue\r\n");
        } else {
            LOG_ERR("GCUMETER\tMSG failed to be put in queue\r\n");
        }

        if (k_msgq_put(&send_data_msgq, &dev_id, K_MSEC(40)) == 0) {
            LOG_INF("Dev id from GCUMETER\tMSG put in queue\r\n");
        } else {
            LOG_ERR("Dev id from GCUMETER\tMSG failed to be put in queue\r\n");
        }

    } else {
        shell_print(shell, "Incorrect GCUMETER cmd format.\r\n");
    }

    return 0;
}

int gcunumeric_h(const struct shell *shell, size_t argc, char *argv[]) {

    if (argc == 2) {
        LOG_DBG("GCUNUMERIC cmd called.\r\n");

        uint8_t dev_id = atoi(argv[1]);

        /* Error Checking. */
        if ((dev_id > 8 || dev_id < 5 || dev_id == 0)) {
            LOG_WRN("Invalid device ID. Valid device IDs are:\r\n5 -> Temperature\r\n6 "
                    "-> Humidity\r\n7 -> Air pressure\r\n8 -> TVOC\r\n");
            return 0;
        }

        uart_msg um;

        um.type = GCU_NUMERIC_TYPE;
        um.length = 2;
        uint8_t data[2] = {1, '\0'};
        um.data = data;
        build_uart_msg(&um);

        if (k_msgq_put(&uart_msgq, &um.msg, K_MSEC(40)) == 0) {
            LOG_INF("GCUNUMERIC\tMSG put in queue\r\n");
        } else {
            LOG_ERR("GCUNUMERIC\tMSG failed to be put in queue\r\n");
        }

        if (k_msgq_put(&send_data_msgq, &dev_id, K_MSEC(40)) == 0) {
            LOG_INF("Dev id from GCUNUMERIC\tMSG put in queue\r\n");
        } else {
            LOG_ERR("Dev id from GCUNUMERIC\tMSG failed to be put in queue\r\n");
        }

    } else {
        shell_print(shell, "Incorrect GCUNUMERIC cmd format.\r\n");
    }

    return 0;
}

int gcurec_h(const struct shell *shell, size_t argc, char *argv[]) {

    if (argc == 4) {
        if (strcmp(argv[1], "-s") == 0) {
            LOG_INF("GCUREC Start cmd called.\r\n");

            uint8_t dev_id = atoi(argv[2]);

            /* Error Checking. */
            if ((dev_id > 8 || dev_id < 5)) {
                LOG_WRN("Invalid device ID. Valid device IDs are:\r\n5 -> Temperature\r\n6 "
                        "-> Humidity\r\n7 -> Air pressure\r\n8 -> TVOC\r\n");
                return 0;
            }

            if ((strlen(argv[3]) != 9) || (argv[3][5] != '.')) {
                LOG_WRN("Invalid file name. Valid file name example is \"abcde.csv\"\r\n");
                return 0;
            }

            // LOG_INF("Dev_id: %d\r\n", dev_id);
            // LOG_INF("File Name: %s\r\n", argv[3]);

            uart_msg um;

            um.type = GCU_SD_TYPE;
            um.length = 11;
            uint8_t data[11];
            data[0] = 1;
            memcpy(data + 1, argv[3], strlen(argv[3]) + 1);
            um.data = data;
            build_uart_msg(&um);

            if (k_msgq_put(&uart_msgq, &um.msg, K_MSEC(40)) == 0) {
                // LOG_INF("GCUREC\tMSG put in queue\r\n");
            } else {
                LOG_ERR("GCUREC\tMSG failed to be put in queue\r\n");
            }

            if (k_msgq_put(&send_data_msgq, &dev_id, K_MSEC(40)) == 0) {
                // LOG_INF("Dev id from GCUREC\tMSG put in queue\r\n");
            } else {
                LOG_ERR("Dev id from GCUREC\tMSG failed to be put in queue\r\n");
            }
        }

    } else if (argc == 2) {

        if (strcmp(argv[1], "-p") == 0) {
            LOG_INF("GCUREC Stop cmd called.\r\n");
            uart_msg um;

            um.type = GCU_SD_TYPE;
            um.length = 2;
            uint8_t data[2] = {0, '\0'};
            um.data = data;
            build_uart_msg(&um);
            uint8_t dev_id = GCU_STOP_DATA_SEND;

            if (k_msgq_put(&uart_msgq, &um.msg, K_MSEC(40)) == 0) {
                // LOG_INF("GCUREC\tMSG put in queue\r\n");
            } else {
                LOG_ERR("GCUREC\tMSG failed to be put in queue\r\n");
            }

            if (k_msgq_put(&send_data_msgq, &dev_id, K_MSEC(40)) == 0) {
                // LOG_INF("Dev id from GCUREC\tMSG put in queue\r\n");
            } else {
                LOG_ERR("Dev id from GCUREC\tMSG failed to be put in queue\r\n");
            }
        }

    } else {
        shell_print(shell, "Incorrect gcurec cmd format.\r\n");
    }

    return 0;
}

/* GCU shell command definitions. */
SHELL_CMD_ARG_REGISTER(point, NULL, "Draw point at [x, y]\r\nExample: point 2 10", point_h, 3, 0);
SHELL_CMD_ARG_REGISTER(move_c, NULL, "Move the current circle to [x, y]\r\nExample: move_c 5 15",
                       move_c_h, 3, 0);
SHELL_CMD_ARG_REGISTER(circle, NULL,
                       "Draw a circle with radius r with a centre at [x, "
                       "y].\r\nExample: circle 4 2 10",
                       circle_h, 4, 0);
SHELL_CMD_ARG_REGISTER(lj, NULL, LJ_CMD_HELP_MSG, lissajous_h, 5, 0);
SHELL_CMD_ARG_REGISTER(dac, NULL, DAC_CMD_HELP_MSG, dac_h, 3, 0);
SHELL_CMD_ARG_REGISTER(gled, NULL, "Toggle the GCU user LEDs.\r\nExample: gled 1 0 1", gled_h, 4,
                       0);
SHELL_CMD_ARG_REGISTER(gpd, NULL, "Read GCU pushbutton state (0, or 1).\r\nExample: gpd", gpd_h, 1,
                       0);
SHELL_CMD_ARG_REGISTER(time, NULL, "Get system time formatted as HH:MM:SS", system_timer_read, 1,
                       1);
SHELL_CMD_ARG_REGISTER(gcugraph, NULL, "Displays the selected sensor values as a graph plot",
                       gcugraph_h, 1, 1);
SHELL_CMD_ARG_REGISTER(gcumeter, NULL, "Displays the selected sensor values as a meter widget",
                       gcumeter_h, 1, 1);
SHELL_CMD_ARG_REGISTER(gcunumeric, NULL, "Displays the selected sensor values as a numeric value",
                       gcunumeric_h, 1, 1);
SHELL_CMD_ARG_REGISTER(gcurec, NULL,
                       "Start and stop writing data to the GCU SD card\r\nNOTE: The file name "
                       "must have a maximum of 5 characters with a three characrter file "
                       "extension. E.g \"abcde.csv\"",
                       gcurec_h, 2, 2);

/* AHU LED cmds */
SHELL_STATIC_SUBCMD_SET_CREATE(led_cmds,
                               SHELL_CMD_ARG(s, NULL,
                                             "set / clear user LEDs with 4 bit bitmask\n"
                                             "usage:\n"
                                             "$ led s <bitmask>\n"
                                             "example: Set LED1 and clear LED2,3,4\n"
                                             "$ led s 1000\n",
                                             led_set, 2, 0),
                               SHELL_CMD_ARG(t, NULL,
                                             "toggle user LEDs with 4 bit bitmask\n"
                                             "usage:\n"
                                             "$ led t <bitmask>\n"
                                             "example: Toggle LED3 and LED4\n"
                                             "$ led t 0011",
                                             led_toggle, 2, 0),
                               SHELL_SUBCMD_SET_END);
SHELL_CMD_REGISTER(led, &led_cmds, "Set, clear, and toggle user LEDs", NULL);
```

## src/shell_commands.h
```c
#ifndef __SHELL_COMMANDS_H__
#define __SHELL_COMMANDS_H__

#include <stdlib.h>

/* Help messages for GCU shell commands */
#define DAC_CMD_HELP_MSG                                                                           \
    "Set the voltage values on the X and Y DACs Voltages must be integers in range [0, "           \
    "33].\r\nExample: Setting voltages to 1.2v and 3v\r\ndac 12 30\r\nNOTED: Any non=integer "     \
    "argument will be interpretted as 0v\r\n"
#define LJ_CMD_HELP_MSG                                                                            \
    "Set that parameters of the sinusoids of the lissajour Curves. Set the amplitude, phase "      \
    "shift, and period of either the x or y sign wave in the following format:\r\n ls 'x'/'y' a "  \
    "b t\r\na: the desired amplitude in decivolts\r\nb: Multiples of pi between 0 and 2. To send " \
    "1.2 enter 12\r\nt: Period in milliseconds.\r\n\nExample: Amplitude of 2.3 volts, phase "      \
    "shift of 1.2*pi, period of 1.5sec\r\nlj 23 12 1500\r\n"

/**
 * Callback for the AHU 'led' shell command.
 */
int led_set(const struct shell *shell, size_t argc, char *argv[]);

/**
 * Callback for the AHU 'led' shell command.
 */
int led_toggle(const struct shell *shell, size_t argc, char *argv[]);

/**
 * Callback for the 'time' shell command.
 */
int system_timer_read(const struct shell *shell, size_t argc, char *argv[]);

/**
 * Callback for the 'point' shell command.
 */
int point_h(const struct shell *shell, size_t argc, char *argv[]);

/**
 * Callback for the 'move_c' shell command.
 */
int move_c_h(const struct shell *shell, size_t argc, char *argv[]);

/**
 * Callback for the 'circle' shell command.
 */
int circle_h(const struct shell *shell, size_t argc, char *argv[]);

/**
 * Callback for the 'lj' shell command.
 */
int lissajous_h(const struct shell *shell, size_t argc, char *argv[]);

/**
 * Callback for the 'dac' shell command.
 */
int dac_h(const struct shell *shell, size_t argc, char *argv[]);

/**
 * Callback for the 'gled' shell command.
 */
int gled_h(const struct shell *shell, size_t argc, char *argv[]);

/**
 * Callback for the 'gpd' shell command.
 */
int gpd_h(const struct shell *shell, size_t argc, char *argv[]);

/**
 * Callback for the 'gcugraph' shell command.
 */
int gcugraph_h(const struct shell *shell, size_t argc, char *argv[]);

/**
 * Callback for the 'gcumeter' shell command.
 */
int gcumeter_h(const struct shell *shell, size_t argc, char *argv[]);

/**
 * Callback for the 'gcugraph' shell command.
 */
int gcurec_h(const struct shell *shell, size_t argc, char *argv[]);
#endif
```

## src/uart_th.c
```c
#include <ctype.h>
#include <stdlib.h>
#include <zephyr/drivers/uart.h>
#include <zephyr/kernel.h>
#include <zephyr/logging/log.h>
#include <zephyr/sys/printk.h>
#include "uart_th.h"

#ifdef CONFIG_ARCH_POSIX
#include <unistd.h>
#else
#include <zephyr/posix/unistd.h>
#endif

LOG_MODULE_DECLARE(stage_2);

/* receive buffer used in UART ISR callback */
static char rx_buf[MSG_SIZE];
static int rx_buf_pos;

const struct device *uart_dev = DEVICE_DT_GET(DT_NODELABEL(uart0));

K_MSGQ_DEFINE(uart_msgq, MSG_SIZE, 10, 4);

/**
 * Takes the attributes in the struct uart_msg and packs them into the array in uart_msg.msg
 * according to the HCI protocol.
 *
 * @param:
 *       um <uart_msg>: uart msg struct.
 */
void build_uart_msg(uart_msg *um) {

    memset(um->msg, 'a', 16);

    um->msg[0] = PREAMBLE;
    um->msg[1] = 0x10 | um->length;

    um->msg[2] = um->type;
    int i = 3;
    int x = 0;
    while (x < um->length) {

        um->msg[i] = um->data[x];
        um->msg[i + 1] = 'a';

        i++;
        x++;
    }

    // LOG_INF("X:%d\r\n", x);
    um->msg[15] = '\0';
}

/*
 * Read characters from UART until line end is detected. Afterwards push the
 * data to the message queue.
 *
 * @params:
 *      dev <const struct device>: Pointer to the UART device node.
 * 		user_data <void *>: Pointer to the data.
 */
void serial_cb(const struct device *dev, void *user_data) {
    uint8_t c;

    if (!uart_irq_update(uart_dev)) {
        return;
    }

    if (!uart_irq_rx_ready(uart_dev)) {
        return;
    }

    /* read until FIFO empty */
    while (uart_fifo_read(uart_dev, &c, 1) == 1) {
        if ((c == '\n' || c == '\r') && rx_buf_pos > 0) {
            /* terminate string */
            rx_buf[rx_buf_pos] = '\0';

            /* if queue is full, message is silently dropped */
            k_msgq_put(&uart_msgq, &rx_buf, K_NO_WAIT);

            /* reset the buffer (it was copied to the msgq) */
            rx_buf_pos = 0;
        } else if (rx_buf_pos < (sizeof(rx_buf) - 1)) {
            rx_buf[rx_buf_pos++] = c;
        }
        /* else: characters beyond buffer size are dropped */
    }
}

/*
 * Print a null-terminated string character by character to the UART interface.
 *
 * @param str The string to print.
 */
void print_uart(char *buf) {

    int msg_len = MSG_SIZE;

    for (int i = 0; i < msg_len; i++) {
        uart_poll_out(uart_dev, buf[i]);
        // LOG_INF("i: %d: %02X\n", i, buf[i]);
    }
}

/**
 * Thread that sends messages to the UART interface.
 *
 * This thread waits for messages to arrive in the queue and then sends them using the Zephyr UART
 * drivers UART interface.
 */
int uart_send_th(void) {

    char tx_buf[MSG_SIZE];

    if (!device_is_ready(uart_dev)) {
        printk("UART device not found!");
        return 0;
    }

    /* configure interrupt and callback to receive data */
    int ret = uart_irq_callback_user_data_set(uart_dev, serial_cb, NULL);

    if (ret < 0) {
        if (ret == -ENOTSUP) {
            printk("Interrupt-driven UART API support not enabled\n");
        } else if (ret == -ENOSYS) {
            printk("UART device does not support interrupt-driven API\n");
        } else {
            printk("Error setting UART callback: %d\n", ret);
        }
        return 0;
    }
    // uart_irq_rx_enable(uart_dev);

    /* Wait to receiver something from the UART queue. */
    while (1) {

        if (k_msgq_get(&uart_msgq, &tx_buf, K_MSEC(100)) == 0) {
            print_uart(tx_buf);
        }
    }

    return 0;
}
```

## src/uart_th.h
```c
#ifndef __UART_TH_H__
#define __UART_TH_H__

#include <stdlib.h>
#define UART_TH_PRIORITY 7
#define UART_TH_STACKSIZE KB(1)

#define MSG_SIZE 16

// Macro definitions for HCI communication protocol.
#define PREAMBLE 0xAA
#define REQUEST 0x01
#define RESPONSE 0x02
#define LEDS_TYPE 0x01

#define DAC_T 2
#define DAC_X 1
#define DAC_Y 2
#define LCP_TYPE 0x03
#define LCP_X 0x01
#define LCP_Y 0x02
#define CIRCLE_TYPE 0x04
#define POINT_TYPE 0x05
#define MOVE_CIRCLE_TYPE 0x06
#define DATA_SEND_TYPE 0x01
#define GCU_GRAPH_TYPE 0x02
#define GCU_METER_TYPE 0x03
#define GCU_NUMERIC_TYPE 0x04
#define GCU_SD_TYPE 0x05
#define GCU_STOP_DATA_SEND 0x00

/* Struct holding attributes for UART message to GCU */
typedef struct uart_msg {

    uint8_t type;
    uint8_t length;
    uint8_t *data;
    uint8_t msg[MSG_SIZE];

} uart_msg;

/**
 * Takes the attributes in the struct uart_msg and packs them into the array in uart_msg.msg
 * according to the HCI protocol.
 *
 * @param:
 *       um <uart_msg>: uart msg struct.
 */
void build_uart_msg(uart_msg *um);

/**
 * Thread that handles sending UART messages to the configured UART peripheral via a queue.
 */
int uart_send_th(void);

#endif
```
