## p2_dk/src/build/Kconfig/arch/Kconfig
```kconfig
# Load arch Kconfig descriptions.
osource "/home/eric/csse4011/prac2/zephyr/arch/x86/Kconfig"
osource "/home/eric/csse4011/prac2/zephyr/arch/xtensa/Kconfig"
osource "/home/eric/csse4011/prac2/zephyr/arch/sparc/Kconfig"
osource "/home/eric/csse4011/prac2/zephyr/arch/riscv/Kconfig"
osource "/home/eric/csse4011/prac2/zephyr/arch/posix/Kconfig"
osource "/home/eric/csse4011/prac2/zephyr/arch/nios2/Kconfig"
osource "/home/eric/csse4011/prac2/zephyr/arch/mips/Kconfig"
osource "/home/eric/csse4011/prac2/zephyr/arch/arm64/Kconfig"
osource "/home/eric/csse4011/prac2/zephyr/arch/arm/Kconfig"
osource "/home/eric/csse4011/prac2/zephyr/arch/arc/Kconfig"
```

## p2_dk/src/build/Kconfig/soc/Kconfig.soc
```kconfig
# Load SoC Kconfig descriptions.
osource "/home/eric/csse4011/prac2/zephyr/soc/espressif/Kconfig.soc"
osource "/home/eric/csse4011/prac2/zephyr/soc/gd/gd32/Kconfig.soc"
osource "/home/eric/csse4011/prac2/zephyr/soc/rockchip/Kconfig.soc"
osource "/home/eric/csse4011/prac2/zephyr/soc/altr/zephyr_nios2f/Kconfig.soc"
osource "/home/eric/csse4011/prac2/zephyr/soc/altr/qemu_nios2/Kconfig.soc"
osource "/home/eric/csse4011/prac2/zephyr/soc/qemu_malta/Kconfig.soc"
osource "/home/eric/csse4011/prac2/zephyr/soc/renesas/rzt2m/Kconfig.soc"
osource "/home/eric/csse4011/prac2/zephyr/soc/renesas/rcar/Kconfig.soc"
osource "/home/eric/csse4011/prac2/zephyr/soc/renesas/ra/Kconfig.soc"
osource "/home/eric/csse4011/prac2/zephyr/soc/renesas/smartbond/Kconfig.soc"
osource "/home/eric/csse4011/prac2/zephyr/soc/xen/Kconfig.soc"
osource "/home/eric/csse4011/prac2/zephyr/soc/nordic/Kconfig.soc"
osource "/home/eric/csse4011/prac2/zephyr/soc/lowrisc/opentitan/Kconfig.soc"
osource "/home/eric/csse4011/prac2/zephyr/soc/atmel/sam0/Kconfig.soc"
osource "/home/eric/csse4011/prac2/zephyr/soc/atmel/sam/Kconfig.soc"
osource "/home/eric/csse4011/prac2/zephyr/soc/ite/ec/Kconfig.soc"
osource "/home/eric/csse4011/prac2/zephyr/soc/andestech/Kconfig.soc"
osource "/home/eric/csse4011/prac2/zephyr/soc/efinix/sapphire/Kconfig.soc"
osource "/home/eric/csse4011/prac2/zephyr/soc/riscv/qemu_virt_riscv/Kconfig.soc"
osource "/home/eric/csse4011/prac2/zephyr/soc/gaisler/gr716a/Kconfig.soc"
osource "/home/eric/csse4011/prac2/zephyr/soc/gaisler/leon3/Kconfig.soc"
osource "/home/eric/csse4011/prac2/zephyr/soc/aspeed/Kconfig.soc"
osource "/home/eric/csse4011/prac2/zephyr/soc/silabs/Kconfig.soc"
osource "/home/eric/csse4011/prac2/zephyr/soc/nuvoton/numaker/Kconfig.soc"
osource "/home/eric/csse4011/prac2/zephyr/soc/nuvoton/numicro/Kconfig.soc"
osource "/home/eric/csse4011/prac2/zephyr/soc/nuvoton/npcx/Kconfig.soc"
osource "/home/eric/csse4011/prac2/zephyr/soc/telink/tlsr/Kconfig.soc"
osource "/home/eric/csse4011/prac2/zephyr/soc/ti/simplelink/Kconfig.soc"
osource "/home/eric/csse4011/prac2/zephyr/soc/ti/lm3s6965/Kconfig.soc"
osource "/home/eric/csse4011/prac2/zephyr/soc/ti/k3/Kconfig.soc"
osource "/home/eric/csse4011/prac2/zephyr/soc/st/stm32/Kconfig.soc"
osource "/home/eric/csse4011/prac2/zephyr/soc/brcm/bcmvk/Kconfig.soc"
osource "/home/eric/csse4011/prac2/zephyr/soc/brcm/bcm2711/Kconfig.soc"
osource "/home/eric/csse4011/prac2/zephyr/soc/native/inf_clock/Kconfig.soc"
osource "/home/eric/csse4011/prac2/zephyr/soc/infineon/xmc/Kconfig.soc"
osource "/home/eric/csse4011/prac2/zephyr/soc/intel/intel_niosv/Kconfig.soc"
osource "/home/eric/csse4011/prac2/zephyr/soc/intel/alder_lake/Kconfig.soc"
osource "/home/eric/csse4011/prac2/zephyr/soc/intel/lakemont/Kconfig.soc"
osource "/home/eric/csse4011/prac2/zephyr/soc/intel/elkhart_lake/Kconfig.soc"
osource "/home/eric/csse4011/prac2/zephyr/soc/intel/intel_socfpga_std/Kconfig.soc"
osource "/home/eric/csse4011/prac2/zephyr/soc/intel/raptor_lake/Kconfig.soc"
osource "/home/eric/csse4011/prac2/zephyr/soc/intel/apollo_lake/Kconfig.soc"
osource "/home/eric/csse4011/prac2/zephyr/soc/intel/atom/Kconfig.soc"
osource "/home/eric/csse4011/prac2/zephyr/soc/intel/intel_socfpga/Kconfig.soc"
osource "/home/eric/csse4011/prac2/zephyr/soc/intel/intel_adsp/Kconfig.soc"
osource "/home/eric/csse4011/prac2/zephyr/soc/intel/intel_ish/Kconfig.soc"
osource "/home/eric/csse4011/prac2/zephyr/soc/neorv32/Kconfig.soc"
osource "/home/eric/csse4011/prac2/zephyr/soc/xlnx/zynqmp/Kconfig.soc"
osource "/home/eric/csse4011/prac2/zephyr/soc/xlnx/zynq7000/Kconfig.soc"
osource "/home/eric/csse4011/prac2/zephyr/soc/ambiq/Kconfig.soc"
osource "/home/eric/csse4011/prac2/zephyr/soc/openisa/rv32m1/Kconfig.soc"
osource "/home/eric/csse4011/prac2/zephyr/soc/microchip/miv/Kconfig.soc"
osource "/home/eric/csse4011/prac2/zephyr/soc/microchip/mec/Kconfig.soc"
osource "/home/eric/csse4011/prac2/zephyr/soc/sifive/sifive_freedom/Kconfig.soc"
osource "/home/eric/csse4011/prac2/zephyr/soc/cypress/Kconfig.soc"
osource "/home/eric/csse4011/prac2/zephyr/soc/nxp/imxrt/Kconfig.soc"
osource "/home/eric/csse4011/prac2/zephyr/soc/nxp/imx/Kconfig.soc"
osource "/home/eric/csse4011/prac2/zephyr/soc/nxp/layerscape/Kconfig.soc"
osource "/home/eric/csse4011/prac2/zephyr/soc/nxp/s32/Kconfig.soc"
osource "/home/eric/csse4011/prac2/zephyr/soc/nxp/kinetis/Kconfig.soc"
osource "/home/eric/csse4011/prac2/zephyr/soc/nxp/lpc/Kconfig.soc"
osource "/home/eric/csse4011/prac2/zephyr/soc/starfive/jh71xx/Kconfig.soc"
osource "/home/eric/csse4011/prac2/zephyr/soc/cdns/xtensa_sample_controller/Kconfig.soc"
osource "/home/eric/csse4011/prac2/zephyr/soc/cdns/dc233c/Kconfig.soc"
osource "/home/eric/csse4011/prac2/zephyr/soc/arm/beetle/Kconfig.soc"
osource "/home/eric/csse4011/prac2/zephyr/soc/arm/Kconfig.soc"
osource "/home/eric/csse4011/prac2/zephyr/soc/quicklogic/eos_s3/Kconfig.soc"
osource "/home/eric/csse4011/prac2/zephyr/soc/raspberrypi/Kconfig.soc"
osource "/home/eric/csse4011/prac2/zephyr/soc/renode/riscv_virtual/Kconfig.soc"
osource "/home/eric/csse4011/prac2/zephyr/soc/synopsys/emsdp/Kconfig.soc"
osource "/home/eric/csse4011/prac2/zephyr/soc/synopsys/qemu_arc/Kconfig.soc"
osource "/home/eric/csse4011/prac2/zephyr/soc/synopsys/hsdk4xd/Kconfig.soc"
osource "/home/eric/csse4011/prac2/zephyr/soc/synopsys/hsdk/Kconfig.soc"
osource "/home/eric/csse4011/prac2/zephyr/soc/synopsys/arc_iot/Kconfig.soc"
osource "/home/eric/csse4011/prac2/zephyr/soc/synopsys/nsim/Kconfig.soc"
osource "/home/eric/csse4011/prac2/zephyr/soc/synopsys/emsk/Kconfig.soc"
osource "/home/eric/csse4011/prac2/zephyr/soc/litex/litex_vexriscv/Kconfig.soc"
```

## p2_thingy/build/Kconfig/Kconfig.modules
```kconfig
menu "acpica (/home/eric/csse4011/prac2/modules/lib/acpica)"
osource "$(ZEPHYR_ACPICA_KCONFIG)"
config ZEPHYR_ACPICA_MODULE
	bool
	default y
endmenu
menu "cmsis (/home/eric/csse4011/prac2/modules/hal/cmsis)"
osource "$(ZEPHYR_CMSIS_KCONFIG)"
config ZEPHYR_CMSIS_MODULE
	bool
	default y
endmenu
menu "cmsis-dsp (/home/eric/csse4011/prac2/modules/lib/cmsis-dsp)"
osource "$(ZEPHYR_CMSIS_DSP_KCONFIG)"
config ZEPHYR_CMSIS_DSP_MODULE
	bool
	default y
endmenu
menu "cmsis-nn (/home/eric/csse4011/prac2/modules/lib/cmsis-nn)"
osource "$(ZEPHYR_CMSIS_NN_KCONFIG)"
config ZEPHYR_CMSIS_NN_MODULE
	bool
	default y
endmenu
menu "fatfs (/home/eric/csse4011/prac2/modules/fs/fatfs)"
osource "$(ZEPHYR_FATFS_KCONFIG)"
config ZEPHYR_FATFS_MODULE
	bool
	default y
endmenu
config ZEPHYR_ALTERA_MODULE
   bool
   default y
menu "hal_ambiq (/home/eric/csse4011/prac2/modules/hal/ambiq)"
osource "$(ZEPHYR_HAL_AMBIQ_KCONFIG)"
config ZEPHYR_HAL_AMBIQ_MODULE
	bool
	default y
endmenu
config ZEPHYR_ATMEL_MODULE
   bool
   default y
menu "hal_espressif (/home/eric/csse4011/prac2/modules/hal/espressif)"
osource "/home/eric/csse4011/prac2/modules/hal/espressif/zephyr/Kconfig"
config ZEPHYR_HAL_ESPRESSIF_MODULE
	bool
	default y
endmenu
menu "hal_ethos_u (/home/eric/csse4011/prac2/modules/hal/ethos_u)"
osource "$(ZEPHYR_HAL_ETHOS_U_KCONFIG)"
config ZEPHYR_HAL_ETHOS_U_MODULE
	bool
	default y
endmenu
menu "hal_gigadevice (/home/eric/csse4011/prac2/modules/hal/gigadevice)"
osource "$(ZEPHYR_HAL_GIGADEVICE_KCONFIG)"
config ZEPHYR_HAL_GIGADEVICE_MODULE
	bool
	default y
endmenu
menu "hal_infineon (/home/eric/csse4011/prac2/modules/hal/infineon)"
osource "$(ZEPHYR_HAL_INFINEON_KCONFIG)"
config ZEPHYR_HAL_INFINEON_MODULE
	bool
	default y
endmenu
config ZEPHYR_HAL_INTEL_MODULE
   bool
   default y
config ZEPHYR_MICROCHIP_MODULE
   bool
   default y
menu "hal_nordic (/home/eric/csse4011/prac2/modules/hal/nordic)"
osource "$(ZEPHYR_HAL_NORDIC_KCONFIG)"
config ZEPHYR_HAL_NORDIC_MODULE
	bool
	default y
endmenu
config ZEPHYR_NUVOTON_MODULE
   bool
   default y
menu "hal_nxp (/home/eric/csse4011/prac2/modules/hal/nxp)"
osource "$(ZEPHYR_HAL_NXP_KCONFIG)"
config ZEPHYR_HAL_NXP_MODULE
	bool
	default y
endmenu
config ZEPHYR_OPENISA_MODULE
   bool
   default y
config ZEPHYR_QUICKLOGIC_MODULE
   bool
   default y
config ZEPHYR_HAL_RENESAS_MODULE
   bool
   default y
menu "hal_rpi_pico (/home/eric/csse4011/prac2/modules/hal/rpi_pico)"
osource "$(ZEPHYR_HAL_RPI_PICO_KCONFIG)"
config ZEPHYR_HAL_RPI_PICO_MODULE
	bool
	default y
endmenu
menu "silabs (/home/eric/csse4011/prac2/modules/hal/silabs)"
osource "/home/eric/csse4011/prac2/modules/hal/silabs/zephyr/Kconfig"
config ZEPHYR_SILABS_MODULE
	bool
	default y
endmenu
menu "hal_st (/home/eric/csse4011/prac2/modules/hal/st)"
osource "$(ZEPHYR_HAL_ST_KCONFIG)"
config ZEPHYR_HAL_ST_MODULE
	bool
	default y
endmenu
config ZEPHYR_STM32_MODULE
   bool
   default y
menu "hal_telink (/home/eric/csse4011/prac2/modules/hal/telink)"
osource "/home/eric/csse4011/prac2/modules/hal/telink/Kconfig"
config ZEPHYR_HAL_TELINK_MODULE
	bool
	default y
endmenu
config ZEPHYR_TI_MODULE
   bool
   default y
config ZEPHYR_HAL_WURTHELEKTRONIK_MODULE
   bool
   default y
config ZEPHYR_XTENSA_MODULE
   bool
   default y
menu "hostap (/home/eric/csse4011/prac2/modules/lib/hostap)"
osource "$(ZEPHYR_HOSTAP_KCONFIG)"
config ZEPHYR_HOSTAP_MODULE
	bool
	default y
endmenu
config ZEPHYR_LIBMETAL_MODULE
   bool
   default y
menu "liblc3 (/home/eric/csse4011/prac2/modules/lib/liblc3)"
osource "$(ZEPHYR_LIBLC3_KCONFIG)"
config ZEPHYR_LIBLC3_MODULE
	bool
	default y
endmenu
menu "littlefs (/home/eric/csse4011/prac2/modules/fs/littlefs)"
osource "$(ZEPHYR_LITTLEFS_KCONFIG)"
config ZEPHYR_LITTLEFS_MODULE
	bool
	default y
endmenu
menu "loramac-node (/home/eric/csse4011/prac2/modules/lib/loramac-node)"
osource "$(ZEPHYR_LORAMAC_NODE_KCONFIG)"
config ZEPHYR_LORAMAC_NODE_MODULE
	bool
	default y
endmenu
menu "lvgl (/home/eric/csse4011/prac2/modules/lib/gui/lvgl)"
osource "/home/eric/csse4011/prac2/modules/lib/gui/lvgl/Kconfig"
config ZEPHYR_LVGL_MODULE
	bool
	default y
endmenu
menu "mbedtls (/home/eric/csse4011/prac2/modules/crypto/mbedtls)"
osource "$(ZEPHYR_MBEDTLS_KCONFIG)"
config ZEPHYR_MBEDTLS_MODULE
	bool
	default y
endmenu
config ZEPHYR_MCUBOOT_MODULE
   bool
   default y
config ZEPHYR_MIPI_SYS_T_MODULE
   bool
   default y
config ZEPHYR_NRF_HW_MODELS_MODULE
   bool
   default y
config ZEPHYR_OPEN_AMP_MODULE
   bool
   default y
menu "openthread (/home/eric/csse4011/prac2/modules/lib/openthread)"
osource "$(ZEPHYR_OPENTHREAD_KCONFIG)"
config ZEPHYR_OPENTHREAD_MODULE
	bool
	default y
endmenu
menu "percepio (/home/eric/csse4011/prac2/modules/debug/percepio)"
osource "/home/eric/csse4011/prac2/modules/debug/percepio/zephyr/Kconfig"
config ZEPHYR_PERCEPIO_MODULE
	bool
	default y
endmenu
menu "picolibc (/home/eric/csse4011/prac2/modules/lib/picolibc)"
osource "/home/eric/csse4011/prac2/modules/lib/picolibc/zephyr/Kconfig"
config ZEPHYR_PICOLIBC_MODULE
	bool
	default y
endmenu
menu "segger (/home/eric/csse4011/prac2/modules/debug/segger)"
osource "$(ZEPHYR_SEGGER_KCONFIG)"
config ZEPHYR_SEGGER_MODULE
	bool
	default y
endmenu
config ZEPHYR_TINYCRYPT_MODULE
   bool
   default y
menu "trusted-firmware-m (/home/eric/csse4011/prac2/modules/tee/tf-m/trusted-firmware-m)"
osource "$(ZEPHYR_TRUSTED_FIRMWARE_M_KCONFIG)"
config ZEPHYR_TRUSTED_FIRMWARE_M_MODULE
	bool
	default y
endmenu
menu "trusted-firmware-a (/home/eric/csse4011/prac2/modules/tee/tf-a/trusted-firmware-a)"
osource "$(ZEPHYR_TRUSTED_FIRMWARE_A_KCONFIG)"
config ZEPHYR_TRUSTED_FIRMWARE_A_MODULE
	bool
	default y
endmenu
menu "uoscore-uedhoc (/home/eric/csse4011/prac2/modules/lib/uoscore-uedhoc)"
osource "$(ZEPHYR_UOSCORE_UEDHOC_KCONFIG)"
config ZEPHYR_UOSCORE_UEDHOC_MODULE
	bool
	default y
endmenu
menu "zcbor (/home/eric/csse4011/prac2/modules/lib/zcbor)"
osource "$(ZEPHYR_ZCBOR_KCONFIG)"
config ZEPHYR_ZCBOR_MODULE
	bool
	default y
endmenu
```
