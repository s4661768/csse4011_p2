## p2_thingy/src/build/Kconfig/soc/Kconfig
```kconfig
# Load Zephyr SoC Kconfig descriptions.
osource "/home/eric/csse4011/prac2/zephyr/soc/espressif/Kconfig"
osource "/home/eric/csse4011/prac2/zephyr/soc/gd/gd32/Kconfig"
osource "/home/eric/csse4011/prac2/zephyr/soc/rockchip/Kconfig"
osource "/home/eric/csse4011/prac2/zephyr/soc/altr/zephyr_nios2f/Kconfig"
osource "/home/eric/csse4011/prac2/zephyr/soc/altr/qemu_nios2/Kconfig"
osource "/home/eric/csse4011/prac2/zephyr/soc/qemu_malta/Kconfig"
osource "/home/eric/csse4011/prac2/zephyr/soc/renesas/rzt2m/Kconfig"
osource "/home/eric/csse4011/prac2/zephyr/soc/renesas/rcar/Kconfig"
osource "/home/eric/csse4011/prac2/zephyr/soc/renesas/ra/Kconfig"
osource "/home/eric/csse4011/prac2/zephyr/soc/renesas/smartbond/Kconfig"
osource "/home/eric/csse4011/prac2/zephyr/soc/xen/Kconfig"
osource "/home/eric/csse4011/prac2/zephyr/soc/nordic/Kconfig"
osource "/home/eric/csse4011/prac2/zephyr/soc/lowrisc/opentitan/Kconfig"
osource "/home/eric/csse4011/prac2/zephyr/soc/atmel/sam0/Kconfig"
osource "/home/eric/csse4011/prac2/zephyr/soc/atmel/sam/Kconfig"
osource "/home/eric/csse4011/prac2/zephyr/soc/ite/ec/Kconfig"
osource "/home/eric/csse4011/prac2/zephyr/soc/andestech/Kconfig"
osource "/home/eric/csse4011/prac2/zephyr/soc/efinix/sapphire/Kconfig"
osource "/home/eric/csse4011/prac2/zephyr/soc/riscv/qemu_virt_riscv/Kconfig"
osource "/home/eric/csse4011/prac2/zephyr/soc/gaisler/gr716a/Kconfig"
osource "/home/eric/csse4011/prac2/zephyr/soc/gaisler/leon3/Kconfig"
osource "/home/eric/csse4011/prac2/zephyr/soc/aspeed/Kconfig"
osource "/home/eric/csse4011/prac2/zephyr/soc/silabs/Kconfig"
osource "/home/eric/csse4011/prac2/zephyr/soc/nuvoton/numaker/Kconfig"
osource "/home/eric/csse4011/prac2/zephyr/soc/nuvoton/numicro/Kconfig"
osource "/home/eric/csse4011/prac2/zephyr/soc/nuvoton/npcx/Kconfig"
osource "/home/eric/csse4011/prac2/zephyr/soc/telink/tlsr/Kconfig"
osource "/home/eric/csse4011/prac2/zephyr/soc/ti/simplelink/Kconfig"
osource "/home/eric/csse4011/prac2/zephyr/soc/ti/lm3s6965/Kconfig"
osource "/home/eric/csse4011/prac2/zephyr/soc/ti/k3/Kconfig"
osource "/home/eric/csse4011/prac2/zephyr/soc/st/stm32/Kconfig"
osource "/home/eric/csse4011/prac2/zephyr/soc/brcm/bcmvk/Kconfig"
osource "/home/eric/csse4011/prac2/zephyr/soc/brcm/bcm2711/Kconfig"
osource "/home/eric/csse4011/prac2/zephyr/soc/native/inf_clock/Kconfig"
osource "/home/eric/csse4011/prac2/zephyr/soc/infineon/xmc/Kconfig"
osource "/home/eric/csse4011/prac2/zephyr/soc/intel/intel_niosv/Kconfig"
osource "/home/eric/csse4011/prac2/zephyr/soc/intel/alder_lake/Kconfig"
osource "/home/eric/csse4011/prac2/zephyr/soc/intel/lakemont/Kconfig"
osource "/home/eric/csse4011/prac2/zephyr/soc/intel/elkhart_lake/Kconfig"
osource "/home/eric/csse4011/prac2/zephyr/soc/intel/intel_socfpga_std/Kconfig"
osource "/home/eric/csse4011/prac2/zephyr/soc/intel/raptor_lake/Kconfig"
osource "/home/eric/csse4011/prac2/zephyr/soc/intel/apollo_lake/Kconfig"
osource "/home/eric/csse4011/prac2/zephyr/soc/intel/atom/Kconfig"
osource "/home/eric/csse4011/prac2/zephyr/soc/intel/intel_socfpga/Kconfig"
osource "/home/eric/csse4011/prac2/zephyr/soc/intel/intel_adsp/Kconfig"
osource "/home/eric/csse4011/prac2/zephyr/soc/intel/intel_ish/Kconfig"
osource "/home/eric/csse4011/prac2/zephyr/soc/neorv32/Kconfig"
osource "/home/eric/csse4011/prac2/zephyr/soc/xlnx/zynqmp/Kconfig"
osource "/home/eric/csse4011/prac2/zephyr/soc/xlnx/zynq7000/Kconfig"
osource "/home/eric/csse4011/prac2/zephyr/soc/ambiq/Kconfig"
osource "/home/eric/csse4011/prac2/zephyr/soc/openisa/rv32m1/Kconfig"
osource "/home/eric/csse4011/prac2/zephyr/soc/microchip/miv/Kconfig"
osource "/home/eric/csse4011/prac2/zephyr/soc/microchip/mec/Kconfig"
osource "/home/eric/csse4011/prac2/zephyr/soc/sifive/sifive_freedom/Kconfig"
osource "/home/eric/csse4011/prac2/zephyr/soc/cypress/Kconfig"
osource "/home/eric/csse4011/prac2/zephyr/soc/nxp/imxrt/Kconfig"
osource "/home/eric/csse4011/prac2/zephyr/soc/nxp/imx/Kconfig"
osource "/home/eric/csse4011/prac2/zephyr/soc/nxp/layerscape/Kconfig"
osource "/home/eric/csse4011/prac2/zephyr/soc/nxp/s32/Kconfig"
osource "/home/eric/csse4011/prac2/zephyr/soc/nxp/kinetis/Kconfig"
osource "/home/eric/csse4011/prac2/zephyr/soc/nxp/lpc/Kconfig"
osource "/home/eric/csse4011/prac2/zephyr/soc/starfive/jh71xx/Kconfig"
osource "/home/eric/csse4011/prac2/zephyr/soc/cdns/xtensa_sample_controller/Kconfig"
osource "/home/eric/csse4011/prac2/zephyr/soc/cdns/dc233c/Kconfig"
osource "/home/eric/csse4011/prac2/zephyr/soc/arm/beetle/Kconfig"
osource "/home/eric/csse4011/prac2/zephyr/soc/arm/Kconfig"
osource "/home/eric/csse4011/prac2/zephyr/soc/quicklogic/eos_s3/Kconfig"
osource "/home/eric/csse4011/prac2/zephyr/soc/raspberrypi/Kconfig"
osource "/home/eric/csse4011/prac2/zephyr/soc/renode/riscv_virtual/Kconfig"
osource "/home/eric/csse4011/prac2/zephyr/soc/synopsys/emsdp/Kconfig"
osource "/home/eric/csse4011/prac2/zephyr/soc/synopsys/qemu_arc/Kconfig"
osource "/home/eric/csse4011/prac2/zephyr/soc/synopsys/hsdk4xd/Kconfig"
osource "/home/eric/csse4011/prac2/zephyr/soc/synopsys/hsdk/Kconfig"
osource "/home/eric/csse4011/prac2/zephyr/soc/synopsys/arc_iot/Kconfig"
osource "/home/eric/csse4011/prac2/zephyr/soc/synopsys/nsim/Kconfig"
osource "/home/eric/csse4011/prac2/zephyr/soc/synopsys/emsk/Kconfig"
osource "/home/eric/csse4011/prac2/zephyr/soc/litex/litex_vexriscv/Kconfig"
```
